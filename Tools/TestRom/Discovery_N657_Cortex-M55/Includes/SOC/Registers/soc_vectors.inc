/*  0 */	PROCESSOR_INTERRUPT(PVD_PVM_IRQn, PVD_PVM_IRQHandler)
/*  1 */	PROCESSOR_INTERRUPT_EMPTY()
/*  2 */	PROCESSOR_INTERRUPT(DTS_IRQn, DTS_IRQHandler)
/*  3 */	PROCESSOR_INTERRUPT(RCC_IRQn, RCC_IRQHandler)
/*  4 */	PROCESSOR_INTERRUPT(LOCKUP_IRQn, LOCKUP_IRQHandler)
/*  5 */	PROCESSOR_INTERRUPT(CACHE_ECC_IRQn, CACHE_ECC_IRQHandler)
/*  6 */	PROCESSOR_INTERRUPT(TCM_ECC_IRQn, TCM_ECC_IRQHandler)
/*  7 */	PROCESSOR_INTERRUPT(BCK_ECC_IRQn, BCK_ECC_IRQHandler)
/*  8 */	PROCESSOR_INTERRUPT(FPU_IRQn, FPU_IRQHandler)
/*  9 */	PROCESSOR_INTERRUPT_EMPTY()
/* 10 */	PROCESSOR_INTERRUPT(RTC_S_IRQn, RTC_S_IRQHandler)
/* 11 */	PROCESSOR_INTERRUPT(TAMP_IRQn, TAMP_IRQHandler)
/* 12 */	PROCESSOR_INTERRUPT(RIFSC_TAMPER_IRQn, RIFSC_TAMPER_IRQHandler)
/* 13 */	PROCESSOR_INTERRUPT(IAC_IRQn, IAC_IRQHandler)
/* 14 */	PROCESSOR_INTERRUPT(RCC_S_IRQn, RCC_S_IRQHandler)
/* 15 */	PROCESSOR_INTERRUPT_EMPTY()
/* 16 */	PROCESSOR_INTERRUPT(RTC_IRQn, RTC_IRQHandler)
/* 17 */	PROCESSOR_INTERRUPT_EMPTY()
/* 18 */	PROCESSOR_INTERRUPT(WDGLS_EARLY_IRQn, WDGLS_EARLY_IRQHandler)
/* 19 */	PROCESSOR_INTERRUPT(WWDG_EARLY_IRQn, WWDG_EARLY_IRQHandler)
/* 20 */	PROCESSOR_INTERRUPT(EXTI0_IRQn, EXTI0_IRQHandler)
/* 21 */	PROCESSOR_INTERRUPT(EXTI1_IRQn, EXTI1_IRQHandler)
/* 22 */	PROCESSOR_INTERRUPT(EXTI2_IRQn, EXTI2_IRQHandler)
/* 23 */	PROCESSOR_INTERRUPT(EXTI3_IRQn, EXTI3_IRQHandler)
/* 24 */	PROCESSOR_INTERRUPT(EXTI4_IRQn, EXTI4_IRQHandler)
/* 25 */	PROCESSOR_INTERRUPT(EXTI5_IRQn, EXTI5_IRQHandler)
/* 26 */	PROCESSOR_INTERRUPT(EXTI6_IRQn, EXTI6_IRQHandler)
/* 27 */	PROCESSOR_INTERRUPT(EXTI7_IRQn, EXTI7_IRQHandler)
/* 28 */	PROCESSOR_INTERRUPT(EXTI8_IRQn, EXTI8_IRQHandler)
/* 29 */	PROCESSOR_INTERRUPT(EXTI9_IRQn, EXTI9_IRQHandler)
/* 30 */	PROCESSOR_INTERRUPT(EXTI10_IRQn, EXTI10_IRQHandler)
/* 31 */	PROCESSOR_INTERRUPT(EXTI11_IRQn, EXTI11_IRQHandler)
/* 32 */	PROCESSOR_INTERRUPT(EXTI12_IRQn, EXTI12_IRQHandler)
/* 33 */	PROCESSOR_INTERRUPT(EXTI13_IRQn, EXTI13_IRQHandler)
/* 34 */	PROCESSOR_INTERRUPT(EXTI14_IRQn, EXTI14_IRQHandler)
/* 35 */	PROCESSOR_INTERRUPT(EXTI15_IRQn, EXTI15_IRQHandler)
/* 36 */	PROCESSOR_INTERRUPT(SAES_IRQn, SAES_IRQHandler)
/* 37 */	PROCESSOR_INTERRUPT(CRYP_IRQn, CRYP_IRQHandler)
/* 38 */	PROCESSOR_INTERRUPT(PKA_IRQn, PKA_IRQHandler)
/* 39 */	PROCESSOR_INTERRUPT(HASH_IRQn, HASH_IRQHandler)
/* 40 */	PROCESSOR_INTERRUPT(RNG_IRQn, RNG_IRQHandler)
/* 41 */	PROCESSOR_INTERRUPT_EMPTY()
/* 42 */	PROCESSOR_INTERRUPT(MCE1_IRQn, MCE1_IRQHandler)
/* 43 */	PROCESSOR_INTERRUPT(MCE2_IRQn, MCE2_IRQHandler)
/* 44 */	PROCESSOR_INTERRUPT(MCE3_IRQn, MCE3_IRQHandler)
/* 45 */	PROCESSOR_INTERRUPT(MCE4_IRQn, MCE4_IRQHandler)
/* 46 */	PROCESSOR_INTERRUPT(ADC12_IRQn, ADC12_IRQHandler)
/* 47 */	PROCESSOR_INTERRUPT(CSI_DBG_IRQn, CSI_DBG_IRQHandler)
/* 48 */	PROCESSOR_INTERRUPT(DCMIPP_IRQn, DCMIPP_IRQHandler)
/* 49 */	PROCESSOR_INTERRUPT_EMPTY()
/* 50 */	PROCESSOR_INTERRUPT_EMPTY()
/* 51 */	PROCESSOR_INTERRUPT_EMPTY()
/* 52 */	PROCESSOR_INTERRUPT(PAHB_ERR_IRQn, PAHB_ERR_IRQHandler)
/* 53 */	PROCESSOR_INTERRUPT(NPU_END_OF_EPOCH_IRQn, NPU_END_OF_EPOCH_IRQHandler)
/* 54 */	PROCESSOR_INTERRUPT(NPU1_IRQn, NPU1_IRQHandler)
/* 55 */	PROCESSOR_INTERRUPT(NPU2_IRQn, NPU2_IRQHandler)
/* 56 */	PROCESSOR_INTERRUPT(NPU3_IRQn, NPU3_IRQHandler)
/* 57 */	PROCESSOR_INTERRUPT(NPUCACHE_IRQn, NPUCACHE_IRQHandler)
/* 58 */	PROCESSOR_INTERRUPT(LTDC_LO_IRQn, LTDC_LO_IRQHandler)
/* 59 */	PROCESSOR_INTERRUPT(LTDC_LO_ERR_IRQn, LTDC_LO_ERR_IRQHandler)
/* 60 */	PROCESSOR_INTERRUPT(DMA2D_IRQn, DMA2D_IRQHandler)
/* 61 */	PROCESSOR_INTERRUPT(JPEG_IRQn, JPEG_IRQHandler)
/* 62 */	PROCESSOR_INTERRUPT(VENC_IRQn, VENC_IRQHandler)
/* 63 */	PROCESSOR_INTERRUPT(GFXMMU_IRQn, GFXMMU_IRQHandler)
/* 64 */	PROCESSOR_INTERRUPT(GFXTIM_IRQn, GFXTIM_IRQHandler)
/* 65 */	PROCESSOR_INTERRUPT(GPU2D_IRQn, GPU2D_IRQHandler)
/* 66 */	PROCESSOR_INTERRUPT(GPU2D_ERROR_IRQn, GPU2D_ERROR_IRQHandler)
/* 67 */	PROCESSOR_INTERRUPT(GPU_CACHE_IRQn, GPU_CACHE_IRQHandler)
/* 68 */	PROCESSOR_INTERRUPT(HPDMA1_CH0_IRQn, HPDMA1_CH0_IRQHandler)
/* 69 */	PROCESSOR_INTERRUPT(HPDMA1_CH1_IRQn, HPDMA1_CH1_IRQHandler)
/* 70 */	PROCESSOR_INTERRUPT(HPDMA1_CH2_IRQn, HPDMA1_CH2_IRQHandler)
/* 71 */	PROCESSOR_INTERRUPT(HPDMA1_CH3_IRQn, HPDMA1_CH3_IRQHandler)
/* 72 */	PROCESSOR_INTERRUPT(HPDMA1_CH4_IRQn, HPDMA1_CH4_IRQHandler)
/* 73 */	PROCESSOR_INTERRUPT(HPDMA1_CH5_IRQn, HPDMA1_CH5_IRQHandler)
/* 74 */	PROCESSOR_INTERRUPT(HPDMA1_CH6_IRQn, HPDMA1_CH6_IRQHandler)
/* 75 */	PROCESSOR_INTERRUPT(HPDMA1_CH7_IRQn, HPDMA1_CH7_IRQHandler)
/* 76 */	PROCESSOR_INTERRUPT(HPDMA1_CH8_IRQn, HPDMA1_CH8_IRQHandler)
/* 77 */	PROCESSOR_INTERRUPT(HPDMA1_CH9_IRQn, HPDMA1_CH9_IRQHandler)
/* 78 */	PROCESSOR_INTERRUPT(HPDMA1_CH10_IRQn, HPDMA1_CH10_IRQHandler)
/* 79 */	PROCESSOR_INTERRUPT(HPDMA1_CH11_IRQn, HPDMA1_CH11_IRQHandler)
/* 80 */	PROCESSOR_INTERRUPT(HPDMA1_CH12_IRQn, HPDMA1_CH12_IRQHandler)
/* 81 */	PROCESSOR_INTERRUPT(HPDMA1_CH13_IRQn, HPDMA1_CH13_IRQHandler)
/* 82 */	PROCESSOR_INTERRUPT(HPDMA1_CH14_IRQn, HPDMA1_CH14_IRQHandler)
/* 83 */	PROCESSOR_INTERRUPT(HPDMA1_CH15_IRQn, HPDMA1_CH15_IRQHandler)
/* 84 */	PROCESSOR_INTERRUPT(GPDMA1_CH0_IRQn, GPDMA1_CH0_IRQHandler)
/* 85 */	PROCESSOR_INTERRUPT(GPDMA1_CH1_IRQn, GPDMA1_CH1_IRQHandler)
/* 86 */	PROCESSOR_INTERRUPT(GPDMA1_CH2_IRQn, GPDMA1_CH2_IRQHandler)
/* 87 */	PROCESSOR_INTERRUPT(GPDMA1_CH3_IRQn, GPDMA1_CH3_IRQHandler)
/* 88 */	PROCESSOR_INTERRUPT(GPDMA1_CH4_IRQn, GPDMA1_CH4_IRQHandler)
/* 89 */	PROCESSOR_INTERRUPT(GPDMA1_CH5_IRQn, GPDMA1_CH5_IRQHandler)
/* 90 */	PROCESSOR_INTERRUPT(GPDMA1_CH6_IRQn, GPDMA1_CH6_IRQHandler)
/* 91 */	PROCESSOR_INTERRUPT(GPDMA1_CH7_IRQn, GPDMA1_CH7_IRQHandler)
/* 92 */	PROCESSOR_INTERRUPT(GPDMA1_CH8_IRQn, GPDMA1_CH8_IRQHandler)
/* 93 */	PROCESSOR_INTERRUPT(GPDMA1_CH9_IRQn, GPDMA1_CH9_IRQHandler)
/* 94 */	PROCESSOR_INTERRUPT(GPDMA1_CH10_IRQn, GPDMA1_CH10_IRQHandler)
/* 95 */	PROCESSOR_INTERRUPT(GPDMA1_CH11_IRQn, GPDMA1_CH11_IRQHandler)
/* 96 */	PROCESSOR_INTERRUPT(GPDMA1_CH12_IRQn, GPDMA1_CH12_IRQHandler)
/* 97 */	PROCESSOR_INTERRUPT(GPDMA1_CH13_IRQn, GPDMA1_CH13_IRQHandler)
/* 98 */	PROCESSOR_INTERRUPT(GPDMA1_CH14_IRQn, GPDMA1_CH14_IRQHandler)
/* 99 */	PROCESSOR_INTERRUPT(GPDMA1_CH15_IRQn, GPDMA1_CH15_IRQHandler)
/*100 */	PROCESSOR_INTERRUPT(I2C1_EV_IRQn, I2C1_EV_IRQHandler)
/*101 */	PROCESSOR_INTERRUPT(I2C1_ER_IRQn, I2C1_ER_IRQHandler)
/*102 */	PROCESSOR_INTERRUPT(I2C2_EV_IRQn, I2C2_EV_IRQHandler)
/*103 */	PROCESSOR_INTERRUPT(I2C2_ER_IRQn, I2C2_ER_IRQHandler)
/*104 */	PROCESSOR_INTERRUPT(I2C3_EV_IRQn, I2C3_EV_IRQHandler)
/*105 */	PROCESSOR_INTERRUPT(I2C3_ER_IRQn, I2C3_ER_IRQHandler)
/*106 */	PROCESSOR_INTERRUPT(I2C4_EV_IRQn, I2C4_EV_IRQHandler)
/*107 */	PROCESSOR_INTERRUPT(I2C4_ER_IRQn, I2C4_ER_IRQHandler)
/*108 */	PROCESSOR_INTERRUPT(I3C1_EV_IRQn, I3C1_EV_IRQHandler)
/*109 */	PROCESSOR_INTERRUPT(I3C1_ER_IRQn, I3C1_ER_IRQHandler)
/*110 */	PROCESSOR_INTERRUPT(I3C2_EV_IRQn, I3C2_EV_IRQHandler)
/*111 */	PROCESSOR_INTERRUPT(I3C2_ER_IRQn, I3C2_ER_IRQHandler)
/*112 */	PROCESSOR_INTERRUPT(TIM1_BRK_IRQn, TIM1_BRK_IRQHandler)
/*113 */	PROCESSOR_INTERRUPT(TIM1_UP_IRQn, TIM1_UP_IRQHandler)
/*114 */	PROCESSOR_INTERRUPT(TIM1_TRG_CCU_IRQn, TIM1_TRG_CCU_IRQHandler)
/*115 */	PROCESSOR_INTERRUPT(TIM1_CC_IRQn, TIM1_CC_IRQHandler)
/*116 */	PROCESSOR_INTERRUPT(TIM2_IRQn, TIM2_IRQHandler)
/*117 */	PROCESSOR_INTERRUPT(TIM3_IRQn, TIM3_IRQHandler)
/*118 */	PROCESSOR_INTERRUPT(TIM4_IRQn, TIM4_IRQHandler)
/*119 */	PROCESSOR_INTERRUPT(TIM5_IRQn, TIM5_IRQHandler)
/*120 */	PROCESSOR_INTERRUPT(TIM6_IRQn, TIM6_IRQHandler)
/*121 */	PROCESSOR_INTERRUPT(TIM7_IRQn, TIM7_IRQHandler)
/*122 */	PROCESSOR_INTERRUPT(TIM8_BRK_IRQn, TIM8_BRK_IRQHandler)
/*123 */	PROCESSOR_INTERRUPT(TIM8_UP_IRQn, TIM8_UP_IRQHandler)
/*124 */	PROCESSOR_INTERRUPT(TIM8_TRG_CCU_IRQn, TIM8_TRG_CCU_IRQHandler)
/*125 */	PROCESSOR_INTERRUPT(TIM8_CC_IRQn, TIM8_CC_IRQHandler)
/*126 */	PROCESSOR_INTERRUPT(TIM9_IRQn, TIM9_IRQHandler)
/*127 */	PROCESSOR_INTERRUPT(TIM10_IRQn, TIM10_IRQHandler)
/*128 */	PROCESSOR_INTERRUPT(TIM11_IRQn, TIM11_IRQHandler)
/*129 */	PROCESSOR_INTERRUPT(TIM12_IRQn, TIM12_IRQHandler)
/*130 */	PROCESSOR_INTERRUPT(TIM13_IRQn, TIM13_IRQHandler)
/*131 */	PROCESSOR_INTERRUPT(TIM14_IRQn, TIM14_IRQHandler)
/*132 */	PROCESSOR_INTERRUPT(TIM15_IRQn, TIM15_IRQHandler)
/*133 */	PROCESSOR_INTERRUPT(TIM16_IRQn, TIM16_IRQHandler)
/*134 */	PROCESSOR_INTERRUPT(TIM17_IRQn, TIM17_IRQHandler)
/*135 */	PROCESSOR_INTERRUPT(TIM18_IRQn, TIM18_IRQHandler)
/*136 */	PROCESSOR_INTERRUPT(LPTIM1_IRQn, LPTIM1_IRQHandler)
/*137 */	PROCESSOR_INTERRUPT(LPTIM2_IRQn, LPTIM2_IRQHandler)
/*138 */	PROCESSOR_INTERRUPT(LPTIM3_IRQn, LPTIM3_IRQHandler)
/*139 */	PROCESSOR_INTERRUPT(LPTIM4_IRQn, LPTIM4_IRQHandler)
/*140 */	PROCESSOR_INTERRUPT(LPTIM5_IRQn, LPTIM5_IRQHandler)
/*141 */	PROCESSOR_INTERRUPT(ADF1_FLT0_IRQn, ADF1_FLT0_IRQHandler)
/*142 */	PROCESSOR_INTERRUPT(MDF1_FLT0_IRQn, MDF1_FLT0_IRQHandler)
/*143 */	PROCESSOR_INTERRUPT(MDF1_FLT1_IRQn, MDF1_FLT1_IRQHandler)
/*144 */	PROCESSOR_INTERRUPT(MDF1_FLT2_IRQn, MDF1_FLT2_IRQHandler)
/*145 */	PROCESSOR_INTERRUPT(MDF1_FLT3_IRQn, MDF1_FLT3_IRQHandler)
/*146 */	PROCESSOR_INTERRUPT(MDF1_FLT4_IRQn, MDF1_FLT4_IRQHandler)
/*147 */	PROCESSOR_INTERRUPT(MDF1_FLT5_IRQn, MDF1_FLT5_IRQHandler)
/*148 */	PROCESSOR_INTERRUPT(SAI1_A_IRQn, SAI1_A_IRQHandler)
/*149 */	PROCESSOR_INTERRUPT(SAI1_B_IRQn, SAI1_B_IRQHandler)
/*150 */	PROCESSOR_INTERRUPT(SAI2_A_IRQn, SAI2_A_IRQHandler)
/*151 */	PROCESSOR_INTERRUPT(SAI2_GLOBAL_B_IRQn, SAI2_GLOBAL_B_IRQHandler)
/*152 */	PROCESSOR_INTERRUPT(SPDIFRX_IRQn, SPDIFRX_IRQHandler)
/*153 */	PROCESSOR_INTERRUPT(SPI1_IRQn, SPI1_IRQHandler)
/*154 */	PROCESSOR_INTERRUPT(SPI2_IRQn, SPI2_IRQHandler)
/*155 */	PROCESSOR_INTERRUPT(SPI3_IRQn, SPI3_IRQHandler)
/*156 */	PROCESSOR_INTERRUPT(SPI4_IRQn, SPI4_IRQHandler)
/*157 */	PROCESSOR_INTERRUPT(SPI5_IRQn, SPI5_IRQHandler)
/*158 */	PROCESSOR_INTERRUPT(SPI6_IRQn, SPI6_IRQHandler)
/*159 */	PROCESSOR_INTERRUPT(USART1_IRQn, USART1_IRQHandler)
/*160 */	PROCESSOR_INTERRUPT(USART2_IRQn, USART2_IRQHandler)
/*161 */	PROCESSOR_INTERRUPT(USART3_IRQn, USART3_IRQHandler)
/*162 */	PROCESSOR_INTERRUPT(UART4_IRQn, UART4_IRQHandler)
/*163 */	PROCESSOR_INTERRUPT(UART5_IRQn, UART5_IRQHandler)
/*164 */	PROCESSOR_INTERRUPT(USART6_IRQn, USART6_IRQHandler)
/*165 */	PROCESSOR_INTERRUPT(UART7_IRQn, UART7_IRQHandler)
/*166 */	PROCESSOR_INTERRUPT(UART8_IRQn, UART8_IRQHandler)
/*167 */	PROCESSOR_INTERRUPT(UART9_IRQn, UART9_IRQHandler)
/*168 */	PROCESSOR_INTERRUPT(USART10_IRQn, USART10_IRQHandler)
/*169 */	PROCESSOR_INTERRUPT(LPUART1_IRQn, LPUART1_IRQHandler)
/*170 */	PROCESSOR_INTERRUPT(XSPI1_IRQn, XSPI1_IRQHandler)
/*171 */	PROCESSOR_INTERRUPT(XSPI2_IRQn, XSPI2_IRQHandler)
/*172 */	PROCESSOR_INTERRUPT(XSPI3_IRQn, XSPI3_IRQHandler)
/*173 */	PROCESSOR_INTERRUPT(FMC_IRQn, FMC_IRQHandler)
/*174 */	PROCESSOR_INTERRUPT(SDMMC1_IRQn, SDMMC1_IRQHandler)
/*175 */	PROCESSOR_INTERRUPT(SDMMC2_IRQn, SDMMC2_IRQHandler)
/*176 */	PROCESSOR_INTERRUPT(UCPD_IRQn, UCPD_IRQHandler)
/*177 */	PROCESSOR_INTERRUPT(OTG1_IRQn, OTG1_IRQHandler)
/*178 */	PROCESSOR_INTERRUPT(OTG2_IRQn, OTG2_IRQHandler)
/*179 */	PROCESSOR_INTERRUPT(ETH1_IRQn, ETH1_IRQHandler)
/*180 */	PROCESSOR_INTERRUPT(FDCAN1_IT0_IRQn, FDCAN1_IT0_IRQHandler)
/*181 */	PROCESSOR_INTERRUPT(FDCAN1_IT1_IRQn, FDCAN1_IT1_IRQHandler)
/*182 */	PROCESSOR_INTERRUPT(FDCAN2_IT0_IRQn, FDCAN2_IT0_IRQHandler)
/*183 */	PROCESSOR_INTERRUPT(FDCAN2_IT1_IRQn, FDCAN2_IT1_IRQHandler)
/*184 */	PROCESSOR_INTERRUPT(FDCAN3_IT0_IRQn, FDCAN3_IT0_IRQHandler)
/*185 */	PROCESSOR_INTERRUPT(FDCAN3_IT1_IRQn, FDCAN3_IT1_IRQHandler)
/*186 */	PROCESSOR_INTERRUPT(FDCAN_CU_IRQn, FDCAN_CU_IRQHandler)
/*187 */	PROCESSOR_INTERRUPT(MDIOS_IRQn, MDIOS_IRQHandler)
/*188 */	PROCESSOR_INTERRUPT(DCMI_PSSI_IRQn, DCMI_PSSI_IRQHandler)
/*189 */	PROCESSOR_INTERRUPT(WAKEUP_PIN_IRQn, WAKEUP_PIN_IRQHandler)
/*190 */	PROCESSOR_INTERRUPT(CTI0_IRQn, CTI0_IRQHandler)
/*191 */	PROCESSOR_INTERRUPT(CTI1_IRQn, CTI1_IRQHandler)
/*192 */	PROCESSOR_INTERRUPT_EMPTY()
/*193 */	PROCESSOR_INTERRUPT(LTDC_UP_IRQn, LTDC_UP_IRQHandler)
/*194 */	PROCESSOR_INTERRUPT(LTDC_UP_ERR_IRQn, LTDC_UP_ERR_IRQHandler)
