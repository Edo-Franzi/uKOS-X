/*  0 */	PROCESSOR_INTERRUPT(TIMER0_IRQ_0_IRQn, TIMER0_IRQ_0_IRQHandler)
/*  1 */	PROCESSOR_INTERRUPT(TIMER0_IRQ_1_IRQn, TIMER0_IRQ_1_IRQHandler)
/*  2 */	PROCESSOR_INTERRUPT(TIMER0_IRQ_2_IRQn, TIMER0_IRQ_2_IRQHandler)
/*  3 */	PROCESSOR_INTERRUPT(TIMER0_IRQ_3_IRQn, TIMER0_IRQ_3_IRQHandler)
/*  4 */	PROCESSOR_INTERRUPT(TIMER1_IRQ_0_IRQn, TIMER1_IRQ_0_IRQHandler)
/*  5 */	PROCESSOR_INTERRUPT(TIMER1_IRQ_1_IRQn, TIMER1_IRQ_1_IRQHandler)
/*  6 */	PROCESSOR_INTERRUPT(TIMER1_IRQ_2_IRQn, TIMER1_IRQ_2_IRQHandler)
/*  7 */	PROCESSOR_INTERRUPT(TIMER1_IRQ_3_IRQn, TIMER1_IRQ_3_IRQHandler)
/*  8 */	PROCESSOR_INTERRUPT(PWM_IRQ_WRAP_0_IRQn, PWM_IRQ_WRAP_0_IRQHandler)
/*  9 */	PROCESSOR_INTERRUPT(PWM_IRQ_WRAP_1_IRQn, PWM_IRQ_WRAP_1_IRQHandler)
/* 10 */	PROCESSOR_INTERRUPT(DMA_IRQ_0_IRQn, DMA_IRQ_0_IRQHandler)
/* 11 */	PROCESSOR_INTERRUPT(DMA_IRQ_1_IRQn, DMA_IRQ_1_IRQHandler)
/* 12 */	PROCESSOR_INTERRUPT(DMA_IRQ_2_IRQn, DMA_IRQ_2_IRQHandler)
/* 13 */	PROCESSOR_INTERRUPT(DMA_IRQ_3_IRQn, DMA_IRQ_3_IRQHandler)
/* 14 */	PROCESSOR_INTERRUPT(USBCTRL_IRQ_IRQn, USBCTRL_IRQ_IRQHandler)
/* 15 */	PROCESSOR_INTERRUPT(PIO0_IRQ_0_IRQn, PIO0_IRQ_0_IRQHandler)
/* 16 */	PROCESSOR_INTERRUPT(PIO0_IRQ_1_IRQn, PIO0_IRQ_1_IRQHandler)
/* 17 */	PROCESSOR_INTERRUPT(PIO1_IRQ_0_IRQn, PIO1_IRQ_0_IRQHandler)
/* 18 */	PROCESSOR_INTERRUPT(PIO1_IRQ_1_IRQn, PIO1_IRQ_1_IRQHandler)
/* 19 */	PROCESSOR_INTERRUPT(PIO2_IRQ_0_IRQn, PIO2_IRQ_0_IRQHandler)
/* 20 */	PROCESSOR_INTERRUPT(PIO2_IRQ_1_IRQn, PIO2_IRQ_1_IRQHandler)
/* 21 */	PROCESSOR_INTERRUPT(IO_IRQ_BANK0_IRQn, IO_IRQ_BANK0_IRQHandler)
/* 22 */	PROCESSOR_INTERRUPT(IO_IRQ_BANK0_NS_IRQn, IO_IRQ_BANK0_NS_IRQHandler)
/* 23 */	PROCESSOR_INTERRUPT(IO_IRQ_QSPI_IRQn, IO_IRQ_QSPI_IRQHandler)
/* 24 */	PROCESSOR_INTERRUPT(IO_IRQ_QSPI_NS_IRQn, IO_IRQ_QSPI_NS_IRQHandler)
/* 25 */	PROCESSOR_INTERRUPT(SIO_IRQ_FIFO_IRQn, SIO_IRQ_FIFO_IRQHandler)
/* 26 */	PROCESSOR_INTERRUPT(SIO_IRQ_BELL_IRQn, SIO_IRQ_BELL_IRQHandler)
/* 27 */	PROCESSOR_INTERRUPT(SIO_IRQ_FIFO_NS_IRQn, SIO_IRQ_FIFO_NS_IRQHandler)
/* 28 */	PROCESSOR_INTERRUPT(SIO_IRQ_BELL_NS_IRQn, SIO_IRQ_BELL_NS_IRQHandler)
/* 29 */	PROCESSOR_INTERRUPT(SIO_IRQ_MTIMECMP_IRQn, SIO_IRQ_MTIMECMP_IRQHandler)
/* 30 */	PROCESSOR_INTERRUPT(CLOCKS_IRQ_IRQn, CLOCKS_IRQ_IRQHandler)
/* 31 */	PROCESSOR_INTERRUPT(SPI0_IRQ_IRQn, SPI0_IRQ_IRQHandler)
/* 32 */	PROCESSOR_INTERRUPT(SPI1_IRQ_IRQn, SPI1_IRQ_IRQHandler)
/* 33 */	PROCESSOR_INTERRUPT(UART0_IRQ_IRQn, UART0_IRQ_IRQHandler)
/* 34 */	PROCESSOR_INTERRUPT(UART1_IRQ_IRQn, UART1_IRQ_IRQHandler)
/* 35 */	PROCESSOR_INTERRUPT(ADC_IRQ_FIFO_IRQn, ADC_IRQ_FIFO_IRQHandler)
/* 36 */	PROCESSOR_INTERRUPT(I2C0_IRQ_IRQn, I2C0_IRQ_IRQHandler)
/* 37 */	PROCESSOR_INTERRUPT(I2C1_IRQ_IRQn, I2C1_IRQ_IRQHandler)
/* 38 */	PROCESSOR_INTERRUPT(OTP_IRQ_IRQn, OTP_IRQ_IRQHandler)
/* 39 */	PROCESSOR_INTERRUPT(TRNG_IRQ_IRQn, TRNG_IRQ_IRQHandler)
/* 40 */	PROCESSOR_INTERRUPT_EMPTY()
/* 41 */	PROCESSOR_INTERRUPT_EMPTY()
/* 42 */	PROCESSOR_INTERRUPT(PLL_SYS_IRQ_IRQn, PLL_SYS_IRQ_IRQHandler)
/* 43 */	PROCESSOR_INTERRUPT(PLL_USB_IRQ_IRQn, PLL_USB_IRQ_IRQHandler)
/* 44 */	PROCESSOR_INTERRUPT(POWMAN_IRQ_POW_IRQn, POWMAN_IRQ_POW_IRQHandler)
/* 45 */	PROCESSOR_INTERRUPT(POWMAN_IRQ_TIMER_IRQn, POWMAN_IRQ_TIMER_IRQHandler)
